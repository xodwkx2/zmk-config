&pro_micro_i2c {
    status = "okay";

    oled: ssd1306@3c {
        compatible = "solomon,ssd1306fb";
        reg = <0x3c>;
        width = <128>;
        height = <32>;     // 128x64 사용 시 64로 변경
        segment-remap;
        page-remap;
        display-offset = <0>;
        multiplex-ratio = <31>; // 128x64 사용 시 63으로 변경
        segment-offset = <0>;
        page-offset = <0>;
        prechargep = <0x22>;
    };
};
